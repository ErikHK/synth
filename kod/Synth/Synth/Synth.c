/*
* Synth.c
*
* Created: 3/24/2013 4:23:53 AM
*  Author: erikhk
*/

#define F_CPU 20000UL

#include <avr/io.h>
#include <util/delay.h>
#include <avr/power.h>
#include <avr/interrupt.h>
#include <avr/pgmspace.h>
#include "l74hc165.h"
#include "lcd.h"


#define F_INT F_CPU/512
//F_INT = 39063 Hz
#define FS F_INT/2
//FS = 19531 Hz

#define MAX_LEVEL 128

#define OSCILLATORS 6
uint16_t freq_coefficient[OSCILLATORS];
uint16_t detune[OSCILLATORS];

uint8_t square_[] = {254,254,254,254,254,254,254,254,254,254,254,254,254,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0,0};

uint8_t sine[] = {128,131,134,137,140,144,147,150,153,156,159,162,165,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125,128};
uint8_t sawtooth[] = {1,2,3,4,5,6,7,8,9,10,11,12,13,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254,255};
uint8_t triangle[] = {0,2,4,6,8,10,12,14,16,18,20,22,24,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2,0};
uint8_t pseudosquare[] = {224,224,225,225,226,227,229,230,231,233,234,235,236,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224,224};

//const uint8_t PROGMEM triangle[] = {1,3,5,7,9,11,13,15,17,19,21,23,25,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3,1};
//const uint8_t PROGMEM bent[] = {1,3,4,6,7,9,10,12,13,15,16,18,19,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0,0};
//const uint8_t PROGMEM noise[] = {37,46,46,55,45,48,45,31,58,51,43,54,59,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55,32};


uint8_t *osc[3];// = &sine_25;
//uint8_t *osc2;
//uint8_t *osc3;
uint8_t i,j;

uint8_t sample=0;
uint8_t sample2=0;

uint8_t tmp_sample = 0;
uint8_t tmp_sample2 = 0;

//which keys are playing right now?
//raw means that they aren't debounced!
uint8_t raw_keys_playing[] = {1,0,0};
//these are one until their release time (adsR) has gone to zero
uint8_t voices_playing[] = {0,0,0};
//the pitch of the different notes, should stay constant!
uint8_t note_values[] = {0,0,0};
//the sample values of the different keys
int8_t sample_values[] = {0,0,0};
//how many keys are pressed right now?
uint8_t n_keys_playing = 1;
//...
uint8_t total_output=0;
//debounce arrays
uint8_t buttons_pressed_confidence[] = {0,0,0};
uint8_t buttons_released_confidence[] = {0,0,0};
//keys_playing, debounced!
uint8_t keys_pressed[] = {0,0,0};
uint8_t keys_released[] = {0,0,0};

uint8_t adsr_counter[]= {0,0,0};

uint8_t counter=0;
uint8_t volume_correction=1;

//uint8_t inputs[1];

//ADSR Envelope, time it takes etc,
//0 is immediate, 16 is around 4 seconds? (for A,D,R!)
uint8_t A[OSCILLATORS], D[OSCILLATORS], S[OSCILLATORS], R[OSCILLATORS];
uint8_t adsr_envelope[OSCILLATORS];
//boolean that switches to 0 when attack is done
uint8_t attack[] = {1,1,1};

//the different current volumes of the voices
uint8_t volumes[] = {0,0,0};
uint16_t lfsr = 0xACE1u;

volatile uint8_t value =0;
char out[4];

//get the length of an array
uint8_t length(uint8_t array[]){
	return (uint8_t)sizeof(array)/sizeof(array[0]);
}

ISR(ADC_vect)
{
	value = ADCH;
	ADCSRA |= (1 << ADSC);
}

int main(void)
{
	//initiate ADC!
	ADCSRA |= (1 << ADEN) | (1 << ADIE) | (1 << ADSC);
	ADMUX |= (1 << ADLAR);
	
	
	
	
	DDRC = 0xff;
	
	A[0] = 0;
	D[0] = 0;
	S[0] = 80;
	R[0] = 0;
	
	
	A[1] = 0;
	D[1] = 0;
	S[1] = 80;
	R[1] = 0;
	
	A[2] = 0;
	D[2] = 0;
	S[2] = 80;
	R[2] = 0;
	
	
	
	//BRA TUTA: 950 som grund, detune0 = 0, detune1=500, detune2=1500! (sawtooth)
	
	
	//PORTC = 0xff;
	
	//3355 when 1000 Hz
	//setfreq(0, 100);
	
	//uint32_t templong;
	
	//templong = 1000;
	//freq_coefficient[0]=60*65536/FS;
	
	freq_coefficient[0] = 400;
	//freq_coefficient[1] = 300;
	//freq_coefficient[1] = 400;
	//freq_coefficient[2] = 600;
	
	detune[0] = 0;
	detune[1] = 0;
	detune[2] = 0;
	
	volumes[0] = 255;
	volumes[1] = 255;
	volumes[2] = 255;
	
	//freq_coefficient[1] = 2000;
	//set global interrupts
	sei();
	//generate_pulse(128);
	osc[0] = sine;
	osc[1] = sawtooth;
	osc[2] = sine;
	//osc[1] = sine;
	//osc[2] = sawtooth;
	
	DDRB = 0xff;
	DDRD = 0xff;
	DDRC = 0xff;
	//PORTB = 0xff;
	
	//TIMER1
	//tone generation
	////////PWM 16 BIT TIMER1////////
	//SET TO FAST PWM, 8 BIT
	
	// for FAST PWM (8-Bit PWM) on OC1A
	//TCCR1A = (1 << WGM10) | (1 << COM1A1);
	TCCR1A = (1 << WGM10);
	
	// tmr1 running on MCU full speed clock
	TCCR1B = (1 << WGM12) |(1 << CS10);
	//TCCR1B = (1 << WGM12) | (1 << CS10) | (1 << CS11);
	
	TIMSK1 |= (1 << TOIE1);
	/////////////////////////////////
	
	//TIMER0
	//other things! AROUND 100 Hz! (20000000/(195*1024))
	////////PWM 8 BIT TIMER0////////
	TIMSK0 = _BV(OCIE0A);  // Enable Interrupt TimerCounter0 Compare Match A (SIG_OUTPUT_COMPARE0A)
	TCCR0A = _BV(WGM01);  // Mode = CTC
	//TCCR0B = _BV(CS02);		//clock/256
	//TCCR0B = _BV(CS00);   //no prescaler
	//TCCR0B = _BV(CS01);		//clock/8
	//TCCR0B = _BV(CS01) | _BV(CS00); //clock/64
	TCCR0B = _BV(CS00) | _BV(CS02);		//clock/1024
	OCR0A = 195;
	////////////////////////////////
	
	
	//TIMER2
	//FOR DEBOUNCING ETC! 1250 Hz! (20000000/(64*250))
	//FOR DEBOUNCING ETC! 25000 Hz! (20000000/(8*100))
	////////PWM 8 BIT TIMER2////////
	TIMSK2 = _BV(OCIE2A); //enable interrupt compare match A
	TCCR2A = _BV(WGM21);  //CTC Mode, TOP at OCR2A
	OCR2A = 100;
	//TCCR2B = _BV(CS22); //clock/64
	
	TCCR2B = _BV(CS21); //clock/8
	//TCCR2B = _BV(CS20); //clock
	////////////////////////////////
	
	//l74hc165_init();
	
	sei();
	
	uint8_t inputs[1];
	
	lcd_init(LCD_DISP_ON);
	//lcd_clrscr();
	lcd_puts("hejsan!");
	//lcd_clrscr();
	
	//DDRA = 0xff;
    while(1)
    {
		
		//play_note(500,0);
		//What to do here?
		//maybe read some inputs!
		//l74hc165_shiftin(inputs);
		
		//PORTC = inputs[0];
		
		//play_note(500,0);
		//keys_pressed[1] = 0;
		//keys_pressed[0] = 0;
		
		//_delay_ms(5000);
		//_delay_ms(5000);
		
		/*
		if(value > 128)
		lcd_puts("hej ");
		else
		lcd_puts("bajs");
		*/
		sprintf(out, "%3i", value);
		lcd_puts(out);
		_delay_ms(4000);
		lcd_clrscr();
    }
}

//tone generation
ISR(TIMER1_OVF_vect)
//ISR(TIMER1_COMPA_vect)
{
	//PORTB = 0xff;
	static uint16_t phase0, phase1, phase2, phase3, phase4, phase5;
	static uint8_t fas;
	static int16_t temp, temp1;
	static uint8_t k=0,flag=0;
	static uint8_t timer;
	static uint16_t noise=0xAA,noise8;
	static uint16_t sig0, sig1, sig2, sig3, sig4, sig5;
	static uint16_t tempphase, tempphase1;
	
	flag ^= 1;
	//if(flag)
	//{
		
		
		//VOICE 1 (3 OSC)
		///////////////////////////////////////
		tempphase = phase0+freq_coefficient[0]; //0.88us
		//sig0 = osc[0][phase0>>8]*voices_playing[0];
		//sig0 = osc[0][phase0>>8];
		//sig0 = osc[0][phase0>>8];
		k = osc[0][phase0>>8];
		//sig0 = osc[0][fas];
		//sig0 = noise8;
		//sig0 = (lfsr>>8)*volumes[0]*voices_playing[0];
		phase0=tempphase;
		fas++;
		/*
		tempphase = phase1+freq_coefficient[0]+10; //0.88us
		//sig1 = osc[1][phase1>>8]*voices_playing[0];
		sig1 = osc[1][phase1>>8];
		//sig0 = noise8;
		//sig0 = (lfsr>>8)*volumes[0]*voices_playing[0];
		phase1=tempphase;
		
		tempphase = phase2+freq_coefficient[0]+20; //0.88us
		//sig2 = osc[2][phase2>>8]*voices_playing[0];
		sig2 = osc[2][phase2>>8];
		//sig0 = noise8;
		//sig2 = (lfsr>>8)*voices_playing[0]*80;
		phase2=tempphase;
		///////////////////////////////////////
		
		
		
		//VOICE 2 (3 OSC)
		///////////////////////////////////////
		tempphase = phase3+freq_coefficient[1]; //0.88us
		//sig0 = osc[0][phase0>>8]*voices_playing[0];
		sig3 = osc[0][phase0>>8];
		//sig0 = noise8;
		//sig0 = (lfsr>>8)*volumes[0]*voices_playing[0];
		phase3=tempphase;
		
		tempphase = phase4+freq_coefficient[1]+10; //0.88us
		//sig1 = osc[1][phase1>>8]*voices_playing[0];
		sig4 = osc[1][phase1>>8];
		//sig0 = noise8;
		//sig0 = (lfsr>>8)*volumes[0]*voices_playing[0];
		phase4=tempphase;
		
		tempphase = phase5+freq_coefficient[1]+20; //0.88us
		//sig2 = osc[2][phase2>>8]*voices_playing[0];
		sig5 = osc[2][phase2>>8];
		//sig0 = noise8;
		//sig2 = (lfsr>>8)*voices_playing[0]*80;
		phase5=tempphase;
		///////////////////////////////////////
		
		
		
		
		//LFSR
		// taps: 16 14 13 11; feedback polynomial: x^16 + x^14 + x^13 + x^11 + 1
		noise8  = ((lfsr >> 0) ^ (lfsr >> 2) ^ (lfsr >> 3) ^ (lfsr >> 5) ) & 1;
		lfsr =  (lfsr >> 1) | (noise8 << 15);
		
		
	//}
	//else
	//{
		//temp = sig0>>8+sig1>>8;
		//temp = sig0>>8;
		//temp += sig1>>8;
		temp=0;
		temp = sig0;
		//temp += sig1;
		//temp += sig2;
		
		temp += sig3;
		temp += sig4;
		temp += sig5;
		*/
		//k = temp>>3;
		//temp = sig0;
		//k = temp;
		//OCR1A = k;
		PORTC = k;
		//PORTC = 0b00000000;
	//}
	
	//generate noise!
	/*
	for(k=1;k<2;k++)
	{
		temp1 = noise;
		noise=noise << 1;
		
		temp1 ^= noise;
		if ( ( temp1 & 0x4000 ) == 0x4000 )
		{
			noise |= 1;
		}
	}
	noise8=noise>>6;
	*/
	
		
	
	/*
	sample_values[0] = square_[sample];
	total_output = sample_values[0];
	sample++;
	
	if(sample > 254)
		sample=0;
	
	OCR1A = total_output;
	*/
	
	//for(i=0;i < length(sample_values);i++)
	//	total_output+=sample_values[i]+128;
	
	//OUTPUT EVERYTHING TO THE PWM
	//OCR1A = total_output/n_keys_playing;
	//total_output=0;
	
	////MOVE THIS, IT SLOWS SHIT DOWN!
	//////////////////////////////////
	//Update the sample values in real time:
	/*
	for(i=0;i < length(sample_values);i++)
	{
		tmp_sample = &osc[0][sample];
		
			sample_values[i] = (volumes[i]*tmp_sample/64)*voices_playing[i];

	}
	*/
	
	
	//tmp_sample = &osc[0][sample];	
	//sample_values[0] = (volumes[0]*tmp_sample/64)*voices_playing[0];
	//sample_values[0] = tmp_sample;
	
	//counter++;
	//if(counter % 2 == 0)
		//sample2++;
		
	//if(counter > 200)
	//	counter=0;
	
	//sample++;
	
	//if(sample > 255)
	//	sample = 0;
		
	//if(sample2 > 63)
	//	sample = 0;
	//////////////////////////////////
}

//Runs at approximately 100 Hz
//16000000/(195*1024)
//Good for sequencer?
ISR(TIMER0_COMPA_vect)
{
	
	//PORTB = 0xff;
	//volume_correction = icr >> 6;
	
	//MOVE THIS, IT SLOWS SHIT DOWN!
	////////////////////////////////
	//Update the sample values in real time:
	//for(i=0;i < length(sample_values);i++)
	//{
		//
		//sample_values[i] = (pgm_read_byte(&(osc[0][sample])))*keys_playing[i];
		////sample_values[i] = (pgm_read_byte(&(osc[0][sample])))*keys_playing[i];
	//}
	//
	//counter++;
	////if(counter % 2 == 0)
	//sample++;
	//
	//if(sample > 63)
	//sample = 0;
	////////////////////////////////
}


void play_note(uint16_t note, uint8_t index)
{
	voices_playing[index] = 1;
	//voices_playing[1] = 1;
	//icr = note;
	//OCR1A = note;
}


//timer for debouncer, ADSR etc, runs at exactly 1250 Hz
//20000000/(250*64) OCR2A = 250, prescaler set to fc/64!
ISR(TIMER2_COMPA_vect)
{
	
	
	//PORTC = 0xff;
	
	//ADSR!
	
	for(uint8_t i=0;i < length(voices_playing);i++)
	{
		adsr_counter[i]++;
		if(voices_playing[i] && keys_pressed[i])
		{

			//hasn't reached top, continue to add to attack
			if(adsr_counter[i] > A[i] && volumes[i] <= MAX_LEVEL && attack[i])
			{
				volumes[i]++;
				adsr_counter[i]=0;
				
				if(volumes[i] == MAX_LEVEL) //stop attacking when it's at the top!
					attack[i] = 0;
			}
			
			//start decaying if attack is finished
			else if(adsr_counter[i] > D[i] && volumes[i] > S[i])
			{
				volumes[i]--;
				adsr_counter[i]=0;
			}
		}
		
		//The key is released! reset things and run release
		if(!keys_pressed[i] && adsr_counter[i] > R[i]){
			if(volumes[i] > 0)
				volumes[i]--;
			else
				voices_playing[i] = 0;
			adsr_counter[i]=0;
			attack[i]=1;
			//volumes[i] = 0;
		}
		
	}
	
	
	
	
	
	
	
	
	
	
	/*
	//ADSR!
	for(i=0;i < length(voices_playing);i++)
	{
		adsr_counter[i]++;
		if(voices_playing[i] && keys_pressed[i])
		{

			//hasn't reached top, continue to add to attack
			if(adsr_counter[i] > A && volumes[i] <= 255 && attack[i])
			{
				volumes[i]++;
				adsr_counter[i]=0;
				
				if(volumes[i] == 0xff) //stop attacking when it's at the top!
					attack[i] = 0;
			}
			
			//start decaying if attack is finished
			else if(adsr_counter[i] > D && volumes[i] > S)
			{
				volumes[i]--;
				adsr_counter[i]=0;
			}
		}
		*/
		/*
		else if(!keys_pressed[i])
		{
			//voices_playing[i] = 0;
			if(volumes[0] > 0)
				volumes[0]--;
			if(volumes[0] == 0)
				voices_playing[i] = 0;
			
		}
		*/
		/*
		//The key is released! reset things and run release
		if(!keys_pressed[i] && adsr_counter[i] > R){
			if(volumes[i] > 0)
				volumes[i]--;
			else
				voices_playing[i] = 0;
			adsr_counter[i]=0;
			attack[i]=1;
			//volumes[i] = 0;
		}
		
	}
	*/
	
	
	
	//button debouncing!
	
	if (PINB & (1 << PB0))
	{
		
		buttons_pressed_confidence[0]++;
		if(buttons_pressed_confidence[0] > 20)
		{
			if(keys_pressed[0] == 0)
			{
				if(PINB & (1 << PB0))
				{
					//play_osc1_note(C5, 1, 5);
					play_note(500,0);
					keys_pressed[0] = 1;
				}
				
				//PORTB ^= 1 << PINB5;
				//PORTB = 1 << PINB5;
			}
			
			buttons_pressed_confidence[0]=0;
		}
	}
	else
	{
		buttons_released_confidence[0]++;
		if(buttons_released_confidence[0] > 20)
		{
			keys_pressed[0] = 0;
			//PORTB = 0 << PINB5;
			buttons_released_confidence[0] = 0;
		}
		
	}
	
	
	
	
	
	
	if (PINB & (1 << PB0))
	{
		
		buttons_pressed_confidence[1]++;
		if(buttons_pressed_confidence[1] > 20)
		{
			if(keys_pressed[1] == 0)
			{
				if(PINB & (1 << PB0))
				{
					//play_osc1_note(C5, 1, 5);
					play_note(300,0);
					keys_pressed[0] = 1;
				}
				
				//PORTB ^= 1 << PINB5;
				//PORTB = 1 << PINB5;
			}
			
			buttons_pressed_confidence[1]=0;
		}
	}
	else
	{
		buttons_released_confidence[1]++;
		if(buttons_released_confidence[1] > 20)
		{
			keys_pressed[1] = 0;
			//PORTB = 0 << PINB5;
			buttons_released_confidence[1] = 0;
		}
		
	}
	
	
	
}


void generate_pulse(uint8_t PW)
{
	uint8_t n;
	int16_t val;
	int8_t *wave_array;
	
	//wave_array = square_;
	
	val=-128;
	
	for(n=0;n<=0xff;n++)
	{
		*wave_array=0xFF;
			if(n>PW) // SID has 12Bit pwm, here we use only 8Bit
			{
				*wave_array&=127;
			}
			else *wave_array&=-127;
			
		val++;
		wave_array++;
	}
}

void setfreq(uint8_t voice, uint16_t freq)
{
	uint32_t templong;
	
	templong=freq;
	freq_coefficient[voice]=templong*65536/FS;
}