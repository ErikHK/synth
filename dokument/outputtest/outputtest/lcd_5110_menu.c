/*
 * lcd_5110_menu.c
 *
 * Created: 2014-12-30 20:39:09
 *  Author: erikhk
 */ 
#include <stdio.h>
#include <avr/io.h>
#include <util/delay.h>
#include <avr/interrupt.h>


#define WIDTH 84
#define HEIGHT 48
//#define F__CPU 8000000L

//GAMLA!!
/*
#define LCD_DDR		DDRD
#define LCD_PORT	PORTD
#define CLK			PD7
#define	DIN			PD5
#define	DC			PD4
#define CE			PD0
#define	RST			PD1
*/

#define LCD_DDR		DDRD
#define LCD_PORT	PORTD
#define CLK			PD5
#define	DIN			PD7
#define	DC			PD0
#define CE			PD4
#define	RST			PD2

#define LCD_COMMAND 0
#define LCD_DATA	1

//4 buttons
#define DDRLEFT		DDRD
#define PINLEFT		PIND
#define PORTLEFT	PORTD
#define LEFT		PD6

#define DDRPORT3	DDRB
#define PORT3		PORTB
#define PIN3		PINB
#define RIGHT		PB1
#define UP			PB2
#define DOWN		PB3


const uint8_t font6x8[][6] =
{
	{ 0x00, 0x00, 0x00, 0x00, 0x00, 0x00 },   // sp
	{ 0x00, 0x00, 0x00, 0x2f, 0x00, 0x00 },   // !
	{ 0x00, 0x00, 0x07, 0x00, 0x07, 0x00 },   // "
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	{ 0x14, 0x14, 0x14, 0x14, 0x14, 0x14 }    // horiz lines
};

const char *main_menu[] = {"Oscillators", "ADSR", "Filters", "Sounds"};
const char *adsr_menu[] = {"Attack", "Decay", "Sustain", "Release"};
const char *oscs_menu[] = {"Osc 1", "Osc 2", "Osc 3", "LFO"};

//const char osc_menu[4][12] = {"Waveform", "Oscillator 2", "Oscillator 3", "LFO"};
const char waveforms[4][12] = {"squ", "sin", "saw", "tri"};

const char filters[2][12] = {"low", "high"};

uint8_t lcd_buffer[504];
uint8_t buttons[] = {0,0,0,0};
uint8_t menuchoice = 0;
uint8_t ** current_menu = adsr_menu;

void setup_4_buttons()
{
	//set inputs
	DDRLEFT &= ~(1 << LEFT);
	DDRPORT3 &= ~(1 << RIGHT);
	DDRPORT3 &= ~(1 << UP);
	DDRPORT3 &= ~(1 << DOWN);
	
	//enable pull-up
	PORTLEFT |= (1 << LEFT);
	PORT3 |= (1 << RIGHT) | (1 << DOWN) | (1 << UP);
	
	//pull-down?
	//PORTLEFT &= ~(1 << LEFT);
	//PORT3 &= ~(1 << RIGHT);
	//PORT3 &= ~(1 << DOWN);
	//PORT3 &= ~(1 << UP);
}

void read_4_buttons()
{
	//left is pressed
	if(PINLEFT & (1 << LEFT))
		buttons[0] = 0;
	else
		buttons[0] = 1;
		
	if(PIN3 & (1 << RIGHT))
		buttons[1] = 0;
	else
		buttons[1] = 1;

	if(PIN3 & (1 << UP))
		buttons[2] = 0;
	else
		buttons[2] = 1;

	if(PIN3 & (1 << DOWN))
		buttons[3] = 0;
	else
		buttons[3] = 1;
		
	if(buttons[0])
		current_menu = main_menu;
	if(buttons[2])
	    current_menu = adsr_menu;
		
	//up
	if(buttons[1] && menuchoice > 0)
	  menuchoice--;
	
	//down
	if(buttons[3] && menuchoice < 5)
	  menuchoice++;
	
}

void LCD_init()
{
	//try some shit
	LCD_DDR = 0xFF;
	LCD_PORT &= ~(1<<RST);
	_delay_ms(100);
	LCD_PORT |= (1<<RST);
	LCD_PORT &= ~(1<<CE);
	_delay_ms(5);
	LCD_PORT &= ~(1<<RST);
	asm("nop");
	LCD_PORT |= (1<<RST);
	
	//set output
	//LCD_DDR = (1<<CLK)|(1<<DIN)|(1<<DC)|(1<<CE)|(1<<RST);
	//DDRD |= 0xff;
	
	//LCD_PORT = 0;
	
	//reset
	LCD_PORT &= ~(1<<RST);
	_delay_us(1);
	LCD_PORT |= (1<<RST);
	
	LCD_PORT &= ~(1<<CE);
	_delay_us(1);
	LCD_PORT |= (1<<CE);
	_delay_us(1);
	
	LCD_PORT |= (1<<RST);
	
	LCD_write_command(0x21);	//Tell LCD that extended commands follow
	//LCD_Write(LCD_COMMAND, 0xC1);	//Set LCD Vop (Contrast): Try 0xB1(good @ 3.3V) or 0xBF if your display is too dark, funkar på första!
	LCD_write_command(0xC1);	//Set LCD Vop (Contrast): Try 0xB1(good @ 3.3V) or 0xBF if your display is too dark
	LCD_write_command(0x06);	//Set temp coeff
	LCD_write_command(0x13);	//LCD bias mode 1:48: Try 0x13 or 0x14
	
	LCD_write_command(0x20);	//We must send 0x20 before modifying the display control mode
	LCD_clear();
	LCD_write_command(0x0C);	//Set display control, normal mode. 0x0D for inverse, 0x0C for non-inverse
	//LCD_Write(LCD_COMMAND, 0x09);	//all segments on
	LCD_PORT &= ~(1<<CE);
	
	/*
	for (uint8_t i=0;i<504;i++)
	{
		lcd_buffer[i] = 0x00;
	}
	*/
}

/*
void LCD_write_string(uint8_t x, uint8_t y, char *s, uint8_t inverted)
{
	while (*s)
	{
		LCD_write_char(x, y, *s++, inverted);
	}
}
*/

void LCD_write_command(uint8_t byte)
{
	uint8_t i;
	
	//set CE low (chip enable, inverted input)
	LCD_PORT &= ~(1<<CE);
	
	//tell the display it's a command or data
	LCD_PORT &= ~(1<<DC);
	
	for (i = 0; i < 8; i++)
	{

		// consider leftmost bit
		// set line high if bit is 1, low if bit is 0
		if (byte & 0x80)
		LCD_PORT |= (1<<DIN);
		else
		LCD_PORT &= ~(1<<DIN);
		
		// pulse clock to indicate that bit value should be read
		LCD_PORT &= ~(1<<CLK);
		// shift byte left so next bit will be leftmost
		byte <<= 1;
		LCD_PORT |= (1<<CLK);
	}
	
	//set CE high
	LCD_PORT |= (1<<CE);
}

void LCD_write_string(uint8_t x, uint8_t y, char *s, uint8_t inverted)
{
	uint8_t i = 0;
	while (*s)
	{
		LCD_write_char(x + i++, y, *s++, inverted);
	}
}


void LCD_write_char(uint8_t x, uint8_t y, uint8_t c, uint8_t inverted)
{
	uint8_t line;

	for (line=0; line<6; line++)
	{
		//LCD_Write_data_at(x,y,font6x8[c-0x20][line], inverted);
		if(inverted)
		  lcd_buffer[x*6+y*WIDTH+line] = ~font6x8[c-0x20][line];
		else
		  lcd_buffer[x*6+y*WIDTH+line] = font6x8[c-0x20][line];
	}
	
}


void LCD_Write_data(uint8_t byte, uint8_t inverted)
{
	static uint16_t ii = 0;
	
	if(inverted)
	lcd_buffer[ii] = ~byte;
	else
	lcd_buffer[ii] = byte;
	
	if(ii > 504)
	ii = 0;
	else
	ii++;
}


void LCD_Write_data_at(uint8_t x, uint8_t y, uint8_t byte, uint8_t inverted)
{
	static uint16_t ii=0;
	
	if(inverted)
		lcd_buffer[x+y*WIDTH+ii] = ~byte;
	else
		lcd_buffer[x+y*WIDTH+ii] = byte;
		
	if(ii > 504)
		ii = 0;
	else
		ii++;
}



void LCD_set_pixel(uint8_t X, uint8_t Y, uint8_t inverted)
{
	uint8_t byte = 0;
	//determine which byte
	uint8_t row = Y>>3;
	
	uint8_t shift = Y-row*8;
	
	if(inverted)
	lcd_buffer[X+row] = (lcd_buffer[X+row] & ~(0x01>>shift));
	else
	lcd_buffer[X+row] = (lcd_buffer[X+row] | 0x01>>shift);
}

void LCD_draw_square(uint8_t x1, uint8_t y1, uint8_t x2, uint8_t y2, uint8_t inverted)
{
	
	for (uint8_t i=y1;i<y2;i++)
	{
		for (uint8_t j=x1;j<x2;j++)
		{
			LCD_set_pixel(j,i, inverted);
		}
		
	}
	
}

void LCD_clear()          // clear the LCD
{
	LCD_clear_buffer();
	LCD_write_buffer();
}



void LCD_write_buffer()
{
	uint8_t i;
	uint16_t j;
	
	//set CE low (chip enable, inverted input)
	LCD_PORT &= ~(1<<CE);
	
	LCD_PORT |= (1<<DC);
	for (j=0;j<504;j++)
	{
		for (i = 0; i < 8; i++)
		{
			// consider leftmost bit
			// set line high if bit is 1, low if bit is 0
			if (lcd_buffer[j] & 0x80)
			LCD_PORT |= (1<<DIN);
			else
			LCD_PORT &= ~(1<<DIN);
			
			// pulse clock to indicate that bit value should be read
			LCD_PORT &= ~(1<<CLK);
			// shift byte left so next bit will be leftmost
			lcd_buffer[j] <<= 1;
			//_delay_us(10);
			asm("nop");
			LCD_PORT |= (1<<CLK);
		}
	}
	
	//set CE high
	LCD_PORT |= (1<<CE);
	
}


void LCD_fill_buffer()
{
	for (uint16_t i=0;i<504;i++)
	{
		lcd_buffer[i] = 0xff;
	}
}

void LCD_clear_buffer()
{
	for (uint16_t i=0;i<504;i++)
	{
		lcd_buffer[i] = 0x00;
	}
}


void LCD_invert_row(uint8_t row)
{
	uint8_t i;
	for (i=0;i<WIDTH;i++)
	{
		lcd_buffer[i+WIDTH*row] = ~lcd_buffer[i+WIDTH*row];
	}
}

void LCD_draw_menu(uint8_t inverted)
{
	for (uint8_t i=0;i<12;i++)
	{
		LCD_write_string(0, i, current_menu[i], inverted);
		if(i == menuchoice)
		  LCD_invert_row(i);
	}
}